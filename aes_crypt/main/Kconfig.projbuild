## aes_crypt/main/Kconfig.projbuild
```kconfig
menu "AES Configuration"

	config AES_CFB128
		bool "Using AES_CFB128 encryption"
		default false
		help
			Using AES_CFB128 encryption.

	config AES_CBC
		bool "Using AES_CBC encryption"
		default false
		help
			Using AES_CBC encryption.

	config AES_ECB
		bool "Using AES_ECB encryption"
		default false
		help
			Using AES_ECB encryption.

endmenu
```

## dhm_key_pair/main/Kconfig.projbuild
```kconfig
menu "AES Configuration"

	choice CRYPTION
		prompt "Select Cryption"
		default IAES_CFB128
		help
			Select Cryption.
		config AES_CFB128
			bool "AES-CFB128 encryption"
			help
				AES-CFB128 encryption.
		config AES_CBC
			bool "AES-CBC encryption"
			help
				AES-CBC encryption.
		config AES_ECB
			bool "AES ECB encryption"
			help
				AES ECB encryption.
	endchoice


endmenu
```

## dhm_key_pair/sdkconfig.defaults
```kconfig
#
# Certificates
#
//CONFIG_MBEDTLS_ECP_C=y
CONFIG_MBEDTLS_DHM_C=y
//CONFIG_MBEDTLS_ECDH_C=y
//CONFIG_MBEDTLS_ECDSA_C=y
```
